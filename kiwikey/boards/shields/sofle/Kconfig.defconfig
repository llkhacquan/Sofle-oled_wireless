## kiwikey/boards/shields/sofle/Kconfig.defconfig
```kconfig
# Standard split configuration (left=central, right=peripheral)
if SHIELD_SOFLE_LEFT

config ZMK_KEYBOARD_NAME
    default "Sofle"

config ZMK_SPLIT_ROLE_CENTRAL
    default y

endif

if SHIELD_SOFLE_LEFT || SHIELD_SOFLE_RIGHT

config ZMK_SPLIT
    default y

if ZMK_DISPLAY

config I2C
    default y

config SSD1306
    default y

endif # ZMK_DISPLAY

if LVGL

config LV_Z_VDB_SIZE
    default 64

config LV_DPI_DEF
    default 148

config LV_Z_BITS_PER_PIXEL
    default 1

choice LV_COLOR_DEPTH
    default LV_COLOR_DEPTH_1
endchoice

endif # LVGL

endif

# Dongle configuration (dongle=central, left+right=peripherals)
if SHIELD_SOFLE_DONGLE

config ZMK_KEYBOARD_NAME
    default "OLED_Dongle"

config ZMK_SPLIT_ROLE_CENTRAL
    default y

config ZMK_SPLIT_BLE_CENTRAL_PERIPHERALS
    default 3

config BT_MAX_CONN
    default 8

config BT_MAX_PAIRED
    default 8

endif

if SHIELD_SOFLE_DONGLE || SHIELD_SOFLE_LEFT_PERIPHERAL

config ZMK_SPLIT
    default y

if ZMK_DISPLAY

config I2C
    default y

config SSD1306
    default y

endif # ZMK_DISPLAY

if LVGL

config LV_Z_VDB_SIZE
    default 64

config LV_DPI_DEF
    default 148

config LV_Z_BITS_PER_PIXEL
    default 1

choice LV_COLOR_DEPTH
    default LV_COLOR_DEPTH_1
endchoice

endif # LVGL

endif
```
